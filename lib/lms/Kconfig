## lib/lms/Kconfig
```kconfig
config MBEDTLS_LMS_C
        bool "LMS stateful-hash public-key signature scheme"
        depends on MBEDTLS_BUILTIN && MBEDTLS_CFG_FILE = "config-tls-generic.h" && !BUILD_WITH_TFM
        select MBEDTLS_PSA_CRYPTO_C
        select PSA_WANT_ALG_SHA_256

config MBEDTLS_LMS_PRIVATE
        bool "LMS private-key operations and signing code"
        depends on MBEDTLS_LMS_C

config LMS_SHELL
        bool "Enable LMS sample code"
        default n
        depends on MBEDTLS_LMS_C
        depends on MBEDTLS
        depends on SHELL
        help
          Enable mbedtls LMS sample code.
```

## mainline/Kconfig
```kconfig
# Copyright (c) 2026 ASPEED Technology Inc.
# SPDX-License-Identifier: Apache-2.0

config ASPEED_ZEPHYR_MAINLINE
	def_bool y
	help
	  Set when the application builds with upstream Zephyr and this module.
	  Application code uses it only where upstream Zephyr lacks an interface
	  the vendor Zephyr tree has.

# The library options of the repository root module.
rsource "../Kconfig"
```

## mainline/drivers/Kconfig
```kconfig
# Copyright (c) 2026 ASPEED Technology Inc.
# SPDX-License-Identifier: Apache-2.0

menu "ASPEED AST2700 BootMCU drivers for mcu-runtime"
orsource "*/Kconfig"
endmenu
```

## mainline/drivers/clock_control/Kconfig
```kconfig
# Copyright (c) 2022 ASPEED Technology Inc.
# SPDX-License-Identifier: Apache-2.0

if CLOCK_CONTROL

# Upstream's CLOCK_CONTROL_AST27XX controls SCU1 only.
config CLOCK_CONTROL_AST27XX_SCU0
	bool "ASPEED AST27XX SCU0 clock control driver"
	default y
	depends on DT_HAS_ASPEED_AST27XX_SCU0_CLOCK_ENABLED
	help
	  Enable the SCU0 clock driver for ASPEED AST27XX series SoCs.

endif # CLOCK_CONTROL
```

## mainline/drivers/crypto/Kconfig
```kconfig
# Copyright (c) 2023 ASPEED Technology Inc.
# SPDX-License-Identifier: Apache-2.0

if CRYPTO

config CPTRA_ECDSA
	bool "ASPEED CPTRA ECDSA engine driver"
	default y
	depends on SOC_AST2700_BOOTMCU && DT_HAS_ASPEED_CPTRA_ECDSA_ENABLED
	help
	  This option enables the Caliptra ECDSA driver for ASPEED SoCs.

config CPTRA_SHA
	bool "ASPEED CPTRA SHA engine driver"
	default y
	depends on SOC_AST2700_BOOTMCU && DT_HAS_ASPEED_CPTRA_SHA_ENABLED
	help
	  This option enables the Caliptra SHA driver for ASPEED SoCs.

config CPTRA_LMS
	bool "ASPEED CPTRA LMS engine driver"
	default y
	depends on SOC_AST2700_BOOTMCU && DT_HAS_ASPEED_CPTRA_LMS_ENABLED
	help
	  This option enables the Caliptra LMS driver for ASPEED SoCs.

endif # CRYPTO
```

## mainline/drivers/entropy/Kconfig
```kconfig
# Copyright (c) 2023 ASPEED Technology Inc.
# SPDX-License-Identifier: Apache-2.0

# The vendor A2 board enables both entropy devices. Express those defaults
# through enabled DT nodes, since upstream's board does not know these drivers.
configdefault ENTROPY_GENERATOR
	default y if DT_HAS_ASPEED_HWRNG_ENABLED || DT_HAS_ASPEED_AST2700_NISTTRNG_ENABLED

if ENTROPY_GENERATOR

config ENTROPY_ASPEED_TRNG
	bool "Aspeed TRNG driver"
	default y
	depends on DT_HAS_ASPEED_HWRNG_ENABLED
	select ENTROPY_HAS_DRIVER
	help
	  This option enables the true random number generator
	  driver based on the SCU HWRNG.

config ENTROPY_ASPEED_NISTTRNG
	bool "Aspeed AST2700 NIST TRNG driver"
	default y
	depends on DT_HAS_ASPEED_AST2700_NISTTRNG_ENABLED
	select ENTROPY_HAS_DRIVER
	help
	  Enable the NIST SP 800-90A compliant CTR_DRBG (AES-256) TRNG
	  driver for the AST2700 SoC. This driver uses the dedicated NIST
	  TRNG hardware block, which is distinct from the legacy SCU HWRNG
	  used by ENTROPY_ASPEED_TRNG.

endif # ENTROPY_GENERATOR
```

## mainline/drivers/misc/Kconfig
```kconfig
# Copyright (c) 2025 ASPEED Technology Inc.
# SPDX-License-Identifier: Apache-2.0

config CPTRA_UPDATE
	bool "ASPEED CPTRA Update driver"
	default y
	depends on SOC_AST2700_BOOTMCU && DT_HAS_ASPEED_CPTRA_UPDATE_ENABLED
	help
	  This option enables the Caliptra update driver for ASPEED SoCs.

config CPTRA_IFC
	bool "ASPEED CPTRA IFC driver"
	default y
	depends on SOC_AST2700_BOOTMCU && DT_HAS_ASPEED_CPTRA_IFC_ENABLED
	help
	  This option enables the Caliptra ifc driver for ASPEED SoCs.

config CPTRA_MBOX
	bool "ASPEED CPTRA MBOX driver"
	default y
	depends on SOC_AST2700_BOOTMCU && DT_HAS_ASPEED_CPTRA_MBOX_ENABLED
	help
	  This option enables the Caliptra mbox driver for ASPEED SoCs.

config CPTRA_DICE
	bool "ASPEED CPTRA DICE driver"
	default y
	depends on SOC_AST2700_BOOTMCU && DT_HAS_ASPEED_CPTRA_DICE_ENABLED
	help
	  This option enables the Caliptra dice driver for ASPEED SoCs.

config CPTRA_MISC
	bool "ASPEED CPTRA MISC driver"
	default y
	depends on SOC_AST2700_BOOTMCU && DT_HAS_ASPEED_CPTRA_MISC_ENABLED
	help
	  This option enables the Caliptra misc driver for ASPEED SoCs.

config CPTRA_IPC
	bool "ASPEED CPTRA IPC driver"
	default y
	depends on SOC_AST2700_BOOTMCU && IPM_BOOTMCU
	depends on CPTRA_ECDSA && CPTRA_SHA && CPTRA_LMS
	depends on CPTRA_UPDATE && CPTRA_DICE && CPTRA_MISC
	help
	  This option enables the Caliptra ipc driver for ASPEED SoCs.

if CPTRA_IPC
module = MISC_ASPEED
module-str = misc-aspeed
source "subsys/logging/Kconfig.template.log_config"
endif

config OTP_AST27XX
	bool "ASPEED AST27XX OTP"
	default y
	depends on DT_HAS_ASPEED_AST27XX_OTP_ENABLED
	help
	  Enable the OTP utility for ASPEED AST27XX SoCs.

config OTP_IPC
	bool "ASPEED OTP IPC driver"
	default y
	depends on SOC_AST2700_BOOTMCU && IPM_BOOTMCU && OTP_AST27XX
	help
	  Let the SSP and the Cortex-A35 read and program the OTP over the
	  BootMCU IPC mailbox, on a command channel of its own.

config PRIVILEGE_CTRL
	bool "Enable ASPEED privilege control"
	default y
	depends on SOC_AST2700_BOOTMCU && DT_HAS_ASPEED_PRICTRL_ENABLED
	help
	  This option enables privilege control for aspeed
	  board isolation.

config EDAF_BRIDGE_ASPEED
	bool "Enable ASPEED eDAF bridge controller"
	default y
	depends on SOC_AST2700_BOOTMCU && DT_HAS_ASPEED_EDAF_BRIDGE_ENABLED
	help
	  This option enables the eDAF bridge controller
	  for ASPEED SoCs.
```

## mainline/drivers/pinctrl/Kconfig
```kconfig
# Copyright (c) 2023 ASPEED Technology Inc.
# SPDX-License-Identifier: Apache-2.0

# The vendor BootMCU SoC enables the pinctrl framework by default.
configdefault PINCTRL
	default y if DT_HAS_ASPEED_G7_SOC1_PINCTRL_ENABLED

if PINCTRL

config PINCTRL_ASPEED_G7
	bool "Pin controller driver for Aspeed G7 SOCs"
	default y
	depends on DT_HAS_ASPEED_G7_SOC1_PINCTRL_ENABLED
	depends on SYSCON
	help
	  Enable pin controller driver for Aspeed G7 SoCs.

config PINCTRL_ASPEED_G7_CONFLICT_CHECK
	bool "Check for Aspeed G7 pin conflicts"
	depends on PINCTRL_ASPEED_G7
	help
	  Track the signal assigned to each ball and reject conflicting pin
	  configurations. Leave disabled to save the RAM used by the ball
	  ownership table. When disabled, later configurations can overwrite
	  an earlier pinmux selection for the same ball.

config PINCTRL_ASPEED_STRING_NAME
	bool "Store the pin name in a string"
	default n
	depends on PINCTRL_ASPEED_G7
	help
	  Enable storing the pin name for debugging.

endif # PINCTRL
```

## mainline/drivers/reset/Kconfig
```kconfig
# Copyright (c) 2022 ASPEED Technology Inc.
# SPDX-License-Identifier: Apache-2.0

if RESET

config RESET_AST27XX
	bool "ASPEED ast27xx reset driver"
	default y
	depends on DT_HAS_ASPEED_AST27XX_RESET_ENABLED
	help
	  This option enables the reset driver for ASPEED AST27XX series SoCs.

# Preserve the vendor BootMCU SoC's reset initialization priority.
configdefault RESET_INIT_PRIORITY
	default SYSCON_INIT_PRIORITY if RESET_AST27XX

endif # RESET
```

## mainline/drivers/sdhc/Kconfig
```kconfig
# Copyright (c) 2023 Intel Corporation
# SPDX-License-Identifier: Apache-2.0

if SDHC

config ASPEED_SDHCI
	bool "ASPEED SDHCI"
	default y
	depends on DT_HAS_ASPEED_SDHCI_ENABLED
	select SDHC_SUPPORTS_NATIVE_MODE
	help
	  Enable Aspeed SDHCI Host Controller.

endif # SDHC
```

## mainline/drivers/spi/Kconfig
```kconfig
# Copyright (c) 2021 ASPEED Technology Inc.
# SPDX-License-Identifier: Apache-2.0

# Selecting SPI here avoids a dependency cycle through entropy over SPI,
# CSPRNG, PSA crypto, FLASH_MAP and FLASH_HAS_DRIVER_ENABLED.
config SPI_ASPEED
	bool "ASPEED SPI(FMC) driver"
	depends on DT_HAS_ASPEED_AST2700_SPI_LITE_CONTROLLER_ENABLED
	depends on FLASH
	select SPI
	select SPI_NOR_MULTI_DEV
	help
	  Enable ASPEED SPI(FMC) controller driver.

config SPI_DMA_SUPPORT_ASPEED
	bool "Enable ASPEED SPI DMA"
	depends on SPI_ASPEED
	default n
	help
	  Enable ASPEED SPI DMA. Both flash and RAM start addresses must
	  be 4-byte aligned.

config SPI_DMA_WRITE_SUPPORT_ASPEED
	bool "Enable ASPEED SPI write DMA"
	depends on SPI_ASPEED && SPI_DMA_SUPPORT_ASPEED
	default n
	help
	  Enable ASPEED SPI write DMA.

config SPI_ASPEED_DMA_POLLING_MODE
	bool
	depends on SPI_ASPEED && SPI_DMA_SUPPORT_ASPEED
	depends on DT_HAS_ASPEED_AST2700_SPI_LITE_CONTROLLER_ENABLED
	default y
	help
	  Force polling mode for ASPEED SPI DMA on BootMCU.
```

## mainline/drivers/watchdog/Kconfig
```kconfig
# Copyright (c) 2023 ASPEED Technology Inc. <chin-ting_kuo@aspeedtech.com>
# SPDX-License-Identifier: Apache-2.0

if WATCHDOG

config WDT_ASPEED
	bool "ASPEED WDT Driver"
	default y
	depends on DT_HAS_ASPEED_AST2700_WATCHDOG_ENABLED
	help
	  Enable ASPEED AST2700 WDT controller driver.

endif # WATCHDOG
```

## mainline/dts/bindings/crypto/aspeed,cptra-ecdsa.yaml
```yaml
# Copyright (c) 2024 ASPEED Technology Inc.
# SPDX-License-Identifier: Apache-2.0

description: ASPEED CPTRA ECDSA Engine

compatible: "aspeed,cptra-ecdsa"

include: base.yaml
```

## mainline/dts/bindings/misc/aspeed,ast2700-edaf-bridge-cfg.yaml
```yaml
# SPDX-License-Identifier: Apache-2.0

description: ASPEED AST2700 EDAF bridge global configuration register block

compatible: "aspeed,ast2700-edaf-bridge-cfg"

include: base.yaml

properties:
  reg:
    required: true
```

## mainline/dts/bindings/misc/aspeed,ast27xx-sac-scu.yaml
```yaml
# Copyright (c) 2026 ASPEED Technology Inc.
# SPDX-License-Identifier: Apache-2.0

description: ASPEED AST27XX SCU access policy configuration

compatible: "aspeed,ast27xx-sac-scu"

include: base.yaml

child-binding:
  description: SCU1 clock gate access policies by master group
  properties:
    psp:
      type: array
      required: true
      description: Clock gate IDs accessible by PSP
    sec-psp:
      type: array
      required: true
      description: Clock gate IDs accessible by secure PSP
    ssp:
      type: array
      required: true
      description: Clock gate IDs accessible by SSP
    tsp:
      type: array
      required: true
      description: Clock gate IDs accessible by TSP
    psp-ssp:
      type: array
      required: true
      description: Clock gate IDs accessible by PSP and SSP
    ssp-tsp:
      type: array
      required: true
      description: Clock gate IDs accessible by SSP and TSP
    bmcu:
      type: array
      required: true
      description: Clock gate IDs accessible by BootMCU
```

## mainline/dts/bindings/misc/aspeed,cptra-ifc.yaml
```yaml
# SPDX-License-Identifier: Apache-2.0

description: ASPEED Caliptra SoC interface register block

compatible: "aspeed,cptra-ifc"

include: base.yaml

properties:
  reg:
    required: true
```

## mainline/dts/bindings/ufs/aspeed,ast2700-ufs.yaml
```yaml
# SPDX-License-Identifier: Apache-2.0

description: ASPEED AST2700 UFS host controller

compatible: "aspeed,ast2700-ufs"

include: base.yaml

properties:
  reg:
    required: true

  clocks:
    required: true

  resets:
    type: phandle-array
    required: true
```

## mainline/soc/ast27xx/Kconfig
```kconfig
# Copyright (c) 2026 ASPEED Technology Inc.
# SPDX-License-Identifier: Apache-2.0

if SOC_AST2700_BOOTMCU

configdefault REBOOT
	default y

endif # SOC_AST2700_BOOTMCU
```
