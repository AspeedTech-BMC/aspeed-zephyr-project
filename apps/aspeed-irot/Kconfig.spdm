## apps/aspeed-irot/Kconfig.spdm
```kconfig
# Copyright (c) 2026 ASPEED Technology Inc.
# SPDX-License-Identifier: MIT

config SPDM_RESPONDER
	bool "SPDM Responder"
	select DMTF_LIBSPDM
	select DMTF_LIBSPDM_RESPONDER
	default n
	help
	  Enable SPDM Responder support.
```

## apps/mcu-runtime/boards/Kconfig
```kconfig
rsource "Kconfig.ast1040_evb"
rsource "Kconfig.ast2700_evb"
rsource "Kconfig.ast2700_haps"
rsource "Kconfig.ast2700_fpga"
rsource "Kconfig.ast2705_evb"
```

## apps/mcu-runtime/boards/Kconfig.ast2700_haps
```kconfig
# SPDX-License-Identifier: Apache-2.0
#
# Copyright (c) 2025 ASPEED Technology Inc.

# Note: This file should be placed to BSP after SLI move to driver layer

if BOARD_AST2700_HAPS
config SLI_AST2700
	bool "Enable AST2700 IO-die SLI calibration"
	depends on SOC_AST2700_BOOTMCU
	help
	  This option enables AST2700 IO-die SLI calibration.

endif


if SLI_AST2700
choice SLI_TARGET_PHYCLK
	prompt "SLI PHY clock selection"
	default SLI_TARGET_PHYCLK_25MHZ

config SLI_TARGET_PHYCLK_1GHZ
	bool "Enable SLI PHY clock 1GHz"

config SLI_TARGET_PHYCLK_800MHZ
	bool "Enable SLI PHY clock 800MHz"

config SLI_TARGET_PHYCLK_500MHZ
	bool "Enable SLI PHY clock 500MHz"

config SLI_TARGET_PHYCLK_400MHZ
	bool "Enable SLI PHY clock 400MHz"

config SLI_TARGET_PHYCLK_25MHZ
	bool "Enable SLI PHY clock 25MHz"
endchoice

config SLI_K_ON_CPU
	bool "Enable SLI calibration on CPU-DIE's delay"
	default n
	help
	  This option enables SLI calibration on CPU-DIE using tx or rx
	  delay except for AHB.
	  Otherwise, it will calibrate by rx delay on both cpu/io-die.

endif
```

## apps/mcu-runtime/src/Kconfig
```kconfig
# SPDX-License-Identifier: Apache-2.0
#
# Copyright (c) 2025 ASPEED Technology Inc.

config USB_UART_PORTS
	string "array to define uarts exposed by usb"
	help
		A comma-separated list of integers.

config ASPEED_DDR_1600
	default n
	bool "ASPEED DDR data rate"
	help
		Choose DDR1600 data rate

config ASPEED_DDR_3200
	default y
	bool "ASPEED DDR data rate"
	help
		Choose DDR3200 data rate

config SYS_LOAD_ADDR
	default 0
	hex "Address in memory to use by default"
	help
	  Address in memory to use as the default safe load address.

config FMC_LOAD_ADDR
	default 0
	hex "Address in memory for FMC firmware"
	help
	  Address in memory to use as the default safe load address for FMC.

config ATF_LOAD_ADDR
	default 0
	hex "Address in memory for ATF firmware"
	help
	  Address in memory to use as the default safe load address for ATF.

config OPTEE_LOAD_ADDR
	default 0
	hex "Address in memory for OPTEE firmware"
	help
	  Address in memory to use as the default safe load address for OPTEE.

config UBOOT_LOAD_ADDR
	default 0
	hex "Address in memory for UBOOT firmware"
	help
	  Address in memory to use as the default safe load address for UBOOT.

config SSP_LOAD_ADDR
	default 0
	hex "Address in memory for SSP firmware"
	help
	  Address in memory to use as the default safe load address for SSP.

config TSP_LOAD_ADDR
	default 0
	hex "Address in memory for TSP firmware"
	help
	  Address in memory to use as the default safe load address for TSP.

config CPTRA_MANIFEST
	bool "Enable CPTRA manifest image loader"
	default n
	help
	  This option enable the CPTRA manifest image loader.

config CPTRA_MANIFEST_SIGNATURE
	bool "Enable CPTRA manifest image signature verification"
	default n
	help
	  This option enables signature verification of CPTRA manifest images,
	  using a hash signed and verified using ECC.

config CPTRA_MANIFEST_OFFSET
	hex "FMC load manifest address"
	default 0x20000000
	help
	  Set the address to load the manifest file for FMC
```

## boards/aspeed/ast1040_interposer/Kconfig.ast1040_interposer
```kconfig
# SPDX-License-Identifier: Apache-2.0
#
# Aspeed AST1040 interposer board configuration
#
# Copyright (c) 2026 ASPEED Technology Inc.

config BOARD_AST1040_INTERPOSER
	select SOC_AST1040_CM4 if BOARD_AST1040_INTERPOSER_AST1040_CM4
```

## boards/aspeed/ast1040_interposer/board.yml
```yaml
board:
  name: ast1040_interposer
  vendor: aspeed
  socs:
    - name: ast1040
      variants:
        - name: cm4
          cpucluster: cm4
```

## boards/aspeed/ast1060_prot_dice/Kconfig.ast1060_prot_dice
```kconfig
# SPDX-License-Identifier: Apache-2.0
#
# Aspeed BIC AST1060 board configuration
#
# Copyright (c) 2026 ASPEED Technology Inc.

config BOARD_AST1060_PROT_DICE
	select SOC_AST1060
```

## boards/aspeed/ast1080_dcscm_oks/ast1080_dcscm_oks_defconfig
```kconfig
CONFIG_SYS_CLOCK_HW_CYCLES_PER_SEC=400000000
CONFIG_SYS_CLOCK_TICKS_PER_SEC=100000
CONFIG_MAIN_STACK_SIZE=4096
CONFIG_BOOTLOADER_SRAM_SIZE=0
CONFIG_HWINFO=y
CONFIG_CONSOLE=y
CONFIG_UART_CONSOLE=y
CONFIG_SERIAL=y
CONFIG_UART_NS16550=y
CONFIG_HEAP_MEM_POOL_SIZE=50000
CONFIG_CLOCK_CONTROL=y
CONFIG_RESET=y
CONFIG_PINCTRL=y
CONFIG_ASSERT=y
# For CMSIS
CONFIG_POLL=y
CONFIG_GPIO=y
CONFIG_GPIO_SHELL=y
# AST1080 (G2) uses the g7 GPIO driver, auto-enabled via devicetree
# (CONFIG_GPIO_ASPEED_G7 / DT_HAS_ASPEED_G7_GPIO_ENABLED).
CONFIG_THREAD_NAME=y
CONFIG_THREAD_STACK_INFO=y
CONFIG_THREAD_MONITOR=y
CONFIG_INIT_STACKS=y
CONFIG_NUM_PREEMPT_PRIORITIES=56
CONFIG_CMSIS_RTOS_V2=y
CONFIG_COMMON_LIBC_MALLOC_ARENA_SIZE=8192
CONFIG_SHELL_STACK_SIZE=4096
CONFIG_CMSIS_V2_EVT_FLAGS_MAX_COUNT=64
```

## boards/aspeed/ast2700_dual_flash_amd/board.yml
```yaml
board:
  name: ast2700_dual_flash_amd
  vendor: aspeed
  socs:
    - name: ast1060
```

## boards/aspeed/ast2700_evb_ast2700_ssp_cl/board.yml
```yaml
board:
  name: ast2700_evb_ast2700_ssp_cl
  vendor: aspeed
  socs:
  - name: ast2700
    variants:
    - name: ddr
      cpucluster: ssp
```

## lib/dmtf/Kconfig
```kconfig
# Copyright (c) 2023 ASPEED Technology Inc.
# SPDX-License-Identifier: MIT

config DMTF_LIBSPDM
	default n
	bool "DMTF LIBSPDM"

if DMTF_LIBSPDM

config DMTF_LIBSPDM_CONFIG_FILE
	string "Project based config file to replace spdm_lib_config.h"

config DMTF_LIBSPDM_OS_STUB_CRYPTLIB_MBEDTLS
	bool "Use mbedTLS in OS stub for LIBSPDM"
	default n

config DMTF_LIBSPDM_OS_STUB_CRYPTLIB_NULL
	bool "Use NULL CryptLib in OS stub for LIBSPDM"
	default n

config DMTF_LIBSPDM_REQUESTOR
	bool "Enable LIBSPDM Requestor"
	default n

config DMTF_LIBSPDM_RESPONDER
	bool "Enable LIBSPDM Responder"
	default n


endif # DMTF_LIBSPDM
```

## lib/hrot_wrapper/Kconfig
```kconfig
# Copyright (c) 2022 ASPEED Technology Inc.
# SPDX-License-Identifier: MIT

config HROT_WRAPPER
	default n
	bool "Hardware root of trust wrapper layer"

choice HROT_HASH_BACKEND
	depends on HROT_WRAPPER
	prompt "HROT hash backend"
	default HROT_HASH_BACKEND_ASPEED if CRYPTO_ASPEED
	default HROT_HASH_BACKEND_CPTRA if CPTRA_MCI_SHA_ACC
	default HROT_HASH_BACKEND_MBEDTLS if MBEDTLS
	help
	  Select the backend used by the HROT hash wrapper.

config HROT_HASH_BACKEND_ASPEED
	bool "ASPEED hardware hash"
	depends on CRYPTO_ASPEED
	help
	  Use the ASPEED Zephyr crypto driver through the HROT HAL.

config HROT_HASH_BACKEND_MBEDTLS
	bool "mbedTLS software hash"
	depends on MBEDTLS
	select MBEDTLS_SHA256
	select MBEDTLS_SHA384
	help
	  Use mbedTLS software SHA-256/SHA-384 through the HROT hash wrapper.

config HROT_HASH_BACKEND_CPTRA
	bool "Caliptra-SS MCI SHA_ACC hardware hash"
	depends on CPTRA_MCI_SHA_ACC
	help
	  Use the Caliptra-SS MCI SHA_ACC engine, which DMA-reads the source
	  instead of copying it through the mailbox. SHA-256 is unsupported;
	  calculate_sha256/start_sha256 always fail.

endchoice
```

## lib/ocp/Kconfig
```kconfig
# Copyright (c) 2026 ASPEED Technology Inc.
# SPDX-License-Identifier: MIT

config BMC_COMPOSITE_EAT_SDK
	default n
	bool "BMC composite EAT SDK"

if BMC_COMPOSITE_EAT_SDK


endif # BMC_COMPOSITE_EAT_SDK
```
