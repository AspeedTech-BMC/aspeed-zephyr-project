## apps/aspeed-pfr/dts/bindings/demo,gpio_basic_api.yaml
```yaml
# Copyright (c) 2022 ASPEED Technology Inc.
# SPDX-License-Identifier: MIT

description: |
    This binding provides resources required to build and run the
    samples/ast1060_evb/demo in Zephyr.

compatible: "demo,gpio_basic_api"

properties:
    out-gpios:
        type: phandle-array
        required: false
        description: |
          Identity of a GPIO that will be configured as an output.  This
          must be on the same device as in-gpios, and physically
          connected to in-gpios.

    in-gpios:
        type: phandle-array
        required: false
        description: |
          Identity of a GPIO that will be configured as an input.  This
          must be on the same device as out-gpios,and physically
          connected to out-gpios.
    bmc-srst-ctrl-out-gpios:
      type: phandle-array
      required: false
      description: Control BMC SRST# signal.

    bmc-extrst-ctrl-out-gpios:
      type: phandle-array
      required: false
      description: Control BMC EXTRST# signal.

    bmc-rst-ind-in-gpios:
      type: phandle-array
      required: false
      description: Detect or monitor BMC reset indicator.

    bmc-cpu1-mux-sel-out-gpios:
      type: phandle-array
      required: false
      description: |
        Control the MUX selection pin which determains
        SPI flash signal from BMC or CPU1.
          0: CPU1
          1: BMC or BIC

    bic-rst-ind-in-gpios:
      type: phandle-array
      required: false
      description: Detect or monitor BIC reset indicator.

    pch-rst-ctrl-out-gpios:
      type: phandle-array
      required: false
      description: Control PCH reset signal.

    cpu0-rst-ind-in-gpios:
      type: phandle-array
      required: false
      description: Detect CPU0 reset indicator.

    cpu1-rst-ind-in-gpios:
      type: phandle-array
      required: false
      description: Detect CPU1 reset indicator.

    cpu0-flash-pwr-out-gpios:
      type: phandle-array
      required: false
      description: PCH CPU0 SPI flash power control.

    cpu1-flash-pwr-out-gpios:
      type: phandle-array
      required: false
      description: PCH CPU1 SPI flash power control.

    platform-state-out-gpios:
      type: phandle-array
      required: false
      description: 8 bit leds for displaying platform state
```

## boards/arm/ast1060_dcscm_amd/Kconfig.defconfig
```kconfig
# SPDX-License-Identifier: Apache-2.0
#
# Aspeed BIC AST1060 board configuration
#
# Copyright (c) 2021 ASPEED Technology Inc.

if BOARD_AST1060_DCSCM_AMD
config BOARD
	default "ast1060_dcscm_amd"
endif # BOARD_AST1060_DCSCM_AMD
```

## boards/arm/ast1060_dcscm_dice/Kconfig.board
```kconfig
# SPDX-License-Identifier: Apache-2.0
#
# Aspeed BIC AST1060 board configuration
#
# Copyright (c) 2021 ASPEED Technology Inc.

config BOARD_AST1060_DCSCM_DICE
	bool "ASPEED AST1060 DCSCM Evaluation Board"
	depends on SOC_AST1060
```

## boards/arm/ast1060_dcscm_dice/Kconfig.defconfig
```kconfig
# SPDX-License-Identifier: Apache-2.0
#
# Aspeed BIC AST1060 board configuration
#
# Copyright (c) 2021 ASPEED Technology Inc.

if BOARD_AST1060_DCSCM_DICE
config BOARD
	default "ast1060_dcscm_dice"
endif # BOARD_AST1060_DCSCM_DICE
```

## boards/arm/ast1060_dual_flash/Kconfig.defconfig
```kconfig
# SPDX-License-Identifier: Apache-2.0
#
# Aspeed BIC AST1060 board configuration
#
# Copyright (c) 2021 ASPEED Technology Inc.

if BOARD_AST1060_DUAL_FLASH
config BOARD
	default "ast1060_dual_flash"
endif # BOARD_AST1060_DUAL_FLASH
```

## boards/arm/ast1060_dual_flash_amd/Kconfig.board
```kconfig
# SPDX-License-Identifier: Apache-2.0
#
# Aspeed BIC AST1060 board configuration
#
# Copyright (c) 2021 ASPEED Technology Inc.

config BOARD_AST1060_DUAL_FLASH_AMD
	bool "ASPEED AST1060 Dual Flash Platform(AMD solution)"
	depends on SOC_AST1060
```

## boards/arm/ast1060_dual_flash_amd/Kconfig.defconfig
```kconfig
# SPDX-License-Identifier: Apache-2.0
#
# Aspeed BIC AST1060 board configuration
#
# Copyright (c) 2021 ASPEED Technology Inc.

if BOARD_AST1060_DUAL_FLASH_AMD
config BOARD
	default "ast1060_dual_flash_amd"
endif # BOARD_AST1060_DUAL_FLASH
```

## boards/arm/ast1060_dual_flash_dice/Kconfig.board
```kconfig
# SPDX-License-Identifier: Apache-2.0
#
# Aspeed BIC AST1060 board configuration
#
# Copyright (c) 2021 ASPEED Technology Inc.

config BOARD_AST1060_DUAL_FLASH_DICE
	bool "ASPEED AST1060 DCSCM Evaluation Board"
	depends on SOC_AST1060
```

## boards/arm/ast1060_mp/Kconfig.board
```kconfig
# SPDX-License-Identifier: Apache-2.0
#
# Aspeed BIC AST1060 board configuration
#
# Copyright (c) 2023 ASPEED Technology Inc.

config BOARD_AST1060_MP
	bool "ASPEED AST1060 DCSCM Evaluation Board"
	depends on SOC_AST1060
```

## boards/arm/ast1060_mp/Kconfig.defconfig
```kconfig
# SPDX-License-Identifier: Apache-2.0
#
# Aspeed BIC AST1060 board configuration
#
# Copyright (c) 2023 ASPEED Technology Inc.

if BOARD_AST1060_MP
config BOARD
	default "ast1060_mp"
endif # BOARD_AST1060_MP
```

## lib/hrot_hal/Kconfig
```kconfig
# Copyright (c) 2022 ASPEED Technology Inc.
# SPDX-License-Identifier: MIT

config HROT_HAL
	bool "Hardware root of trust hardware abstraction layer"

config SPI_DMA_SUPPORT_ASPEED
        depends on SPI_ASPEED
        bool "Enable ASPEED SPI DMA"
        default n
        help
          Enable ASPEED SPI DMA. Notice, both
          flash start addrss and ram start address
          MUST be 4-byte aligned.
```

## modules/Cerberus/Kconfig
```kconfig
# Copyright (c) 2022 ASPEED Technology Inc.
# SPDX-License-Identifier: MIT

config CERBERUS
	bool "Cerberus support"

if CERBERUS
	config CERBERUS_MCTP
	depends on CERBERUS
	default n
	bool "Cerberus MCTP support"
	help
	  Enable Cerberus MCTP protocol support.

	config CERBERUS_MCTP_TEST_ECHO
	depends on CERBERUS_MCTP
        default n
        bool "Cerberus MCTP echo command"
        help
          Cerberus MCTP echo command support for large message test.
endif
```
