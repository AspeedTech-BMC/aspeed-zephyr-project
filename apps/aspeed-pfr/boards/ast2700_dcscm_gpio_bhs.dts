/ {
	pfr_gpio_bhs {
		compatible = "aspeed,pfr-gpio-bhs";
		/* For AST2700 DCSCM Card */
		rst-pltrst-in-gpios = <&sgpiom_e_h 2 0>; /* SGPI34 */
		pwrgd-cpu0-out-gpios = <&sgpiom_e_h 5 0>;      /* SGPO37 */
		rst-rtcrst-cpu0-out-gpios = <&sgpiom_e_h 4 0>; /* SGPO36 */
		rst-pltrst-cpu0-out-gpios = <&sgpiom_e_h 6 0>; /* SGPO38 */
		rst-rtcrst-cpu1-out-gpios = <&sgpiom_e_h 20 0>; /* SGPO52 */
		pwrgd-cpu1-out-gpios = <&sgpiom_e_h 21 0>;      /* SGPO53 */
		rst-pltrst-cpu1-out-gpios = <&sgpiom_e_h 22 0>; /* SGPO54 */
		i3c-mng-mux-sel-out-gpios = <&gpio0_m_p 12 0>; /* GPIO_N4 */
		scm-board-id0-in-gpios = <&sgpiom_a_d 1 0>;
		scm-rsu-hide-done-in-gpios = <&sgpiom_e_h 10 0>; /* SGPI42 */
		scm-rsu-hide-out-gpios = <&sgpiom_a_d 16 0>; /* SGPO16*/
		fp-pwr-btn-in-gpios = <&sgpiom_e_h 9 0>; /* SGPI41 */
		bmc-pwr-btn-out-gpios = <&sgpiom_a_d 9 0>; /* SGPO9 */
	};
};

