/ {
	pfr_gpio_bhs {
		compatible = "aspeed,pfr-gpio-bhs";

		// 0-31
		pwrgd-cpu0-out-gpios = <&sgpiom_a_d 5 0>;
		rst-pltrst-cpu0-out-gpios = <&sgpiom_a_d 10 0>;
		rst-rtcrst-cpu0-out-gpios = <&sgpiom_a_d 11 0>;
		bmc-pwr-btn-out-gpios = <&sgpiom_a_d 15 0>;

		// 32-63
		rst-pltrst-in-gpios = <&sgpiom_e_h 2 0>;
		fp-pwr-btn-in-gpios = <&sgpiom_e_h 25 0>;
	};
};

